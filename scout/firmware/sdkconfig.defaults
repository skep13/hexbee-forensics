## scout/firmware/sdkconfig.defaults
```kconfig
# HexBee Scout — ESP32-S3 defaults
CONFIG_IDF_TARGET="esp32s3"

# TinyUSB device stack (USB OTG) for the acquisition interface
CONFIG_TINYUSB=y

# Reasonable Wi-Fi buffers for a 512 KB SRAM part doing MQTT
CONFIG_ESP_WIFI_STATIC_RX_BUFFER_NUM=8
CONFIG_ESP_WIFI_DYNAMIC_RX_BUFFER_NUM=16

# mbedTLS needed once the broker moves to TLS (hexbee roadmap)
CONFIG_MBEDTLS_CERTIFICATE_BUNDLE=y

# NVS for offline event buffering across reboots
CONFIG_NVS_ENCRYPTION=n
```
